## Build/layer_hello_world/conf/layer.conf
```bitbake
# We have a conf and classes directory, add to BBPATH
BBPATH .= ":${LAYERDIR}"

# We have recipes-* directories, add to BBFILES
BBFILES += "${LAYERDIR}/recipes-*/*/*.bb \
            ${LAYERDIR}/recipes-*/*/*.bbappend"

BBFILE_COLLECTIONS += "layer_hello_world"
BBFILE_PATTERN_layer_hello_world = "^${LAYERDIR}/"
BBFILE_PRIORITY_layer_hello_world = "6"

LAYERDEPENDS_layer_hello_world = "core"
LAYERSERIES_COMPAT_layer_hello_world = "gatesgarth"
```
